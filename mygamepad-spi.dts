/dts-v1/;
/plugin/;

/ {
    compatible = "brcm,bcm2835";
    fragment@0 {
        target = <&spidev0>;
        __overlay__ {
            status = "disabled";
        };
     };
    fragment@1 {
        target = <&spi0>;
        __overlay__ {
            #address-cells = <1>;
            #size-cells = <0>;
            mygamepad-spi@0 {
                compatible="mygamepad";
                reg = <0x00>;
                spi-max-frequency = <0x3d0900>;
            };
        };
    };
};